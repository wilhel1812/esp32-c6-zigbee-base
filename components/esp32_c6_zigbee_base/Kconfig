## components/esp32_c6_zigbee_base/Kconfig
```kconfig
menu "ESP32-C6 Zigbee Base"

    config ESP32_C6_ZIGBEE_BASE_MANUFACTURER_NAME
        string "Default Basic cluster manufacturer name"
        default "Wilhelm Advocaat-Marum"
        help
            Default Zigbee Basic cluster ManufacturerName value used when
            product firmware does not override manufacturer_name in
            esp32_c6_zigbee_base_config_t.

    config ESP32_C6_ZIGBEE_BASE_MODEL_IDENTIFIER
        string "Default Basic cluster model identifier"
        default "ESP32-C6 Zigbee Base"
        help
            Default Zigbee Basic cluster ModelIdentifier value used when
            product firmware does not override model_identifier.

    config ESP32_C6_ZIGBEE_BASE_DATE_CODE
        string "Default Basic cluster date code"
        default "20260605"
        help
            Default Zigbee Basic cluster DateCode value. Use YYYYMMDD for
            release builds.

    config ESP32_C6_ZIGBEE_BASE_SW_BUILD_ID
        string "Default Basic cluster software build ID"
        default "0.1.2"
        help
            Default Zigbee Basic cluster SWBuildID value. Use SemVer without
            the leading v.

    config ESP32_C6_ZIGBEE_BASE_APPLICATION_VERSION
        int "Default Basic cluster application version"
        range 0 255
        default 3
        help
            Default Zigbee Basic cluster ApplicationVersion value. Increment
            this numeric value for each released firmware version.

    config ESP32_C6_ZIGBEE_BASE_HARDWARE_VERSION
        int "Default Basic cluster hardware version"
        range 0 255
        default 1
        help
            Default Zigbee Basic cluster HWVersion value for the reference
            hardware target.

endmenu
```

## examples/generic_device/sdkconfig.defaults
```kconfig
CONFIG_PARTITION_TABLE_CUSTOM=y
CONFIG_PARTITION_TABLE_CUSTOM_FILENAME="partitions.csv"
CONFIG_ZB_ENABLED=y
CONFIG_ESP32_C6_ZIGBEE_BASE_MANUFACTURER_NAME="Wilhelm Advocaat-Marum"
CONFIG_ESP32_C6_ZIGBEE_BASE_MODEL_IDENTIFIER="ESP32-C6 Zigbee Base"
CONFIG_ESP32_C6_ZIGBEE_BASE_DATE_CODE="20260605"
CONFIG_ESP32_C6_ZIGBEE_BASE_SW_BUILD_ID="0.1.7"
CONFIG_ESP32_C6_ZIGBEE_BASE_APPLICATION_VERSION=8
CONFIG_ESP32_C6_ZIGBEE_BASE_HARDWARE_VERSION=1
```
